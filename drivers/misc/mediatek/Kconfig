## drivers/misc/mediatek/Kconfig
```kconfig
# SPDX-License-Identifier: GPL-2.0
source "drivers/misc/mediatek/connectivity/Kconfig"
source "drivers/misc/mediatek/uarthub/Kconfig"
source "drivers/misc/mediatek/ccci_util/Kconfig"
source "drivers/misc/mediatek/ccmni/Kconfig"
source "drivers/misc/mediatek/eccci/Kconfig"
source "drivers/misc/mediatek/rps/Kconfig"
source "drivers/misc/mediatek/scp/Kconfig"
source "drivers/misc/mediatek/conn_scp/Kconfig"
source "drivers/misc/mediatek/fingerprint/Kconfig"
```

## drivers/misc/mediatek/fingerprint/Kconfig
```kconfig
# SPDX-License-Identifier: GPL-2.0
config UFF_FINGERPRINT_REE_SPI
	tristate "Oplus UFF fingerprint over REE SPI"
	depends on SPI
	help
	  Oplus/Goodix under-display fingerprint transport driver for the
	  REE (non-TEE) SPI path.  Exposes /dev/fingerprint_dev with raw SPI
	  transfers plus power/reset/IRQ controls; the sensor protocol and
	  matching live in userspace.

	  Say Y to build it into the kernel (needed for the RMX6688 initramfs).
```
